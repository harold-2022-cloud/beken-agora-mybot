## projects/beken_agent_http/ap/Kconfig.projbuild
```kconfig
menu "BEKEN GENIE RINO Configuration"
    config LDO3V3_ENABLE
        bool "Enable LDO_3V3"
        default n

    config LDO3V3_CTRL_GPIO
        depends on LDO3V3_ENABLE
        int "Set LDO_3V3 Control Gpio"
        range 0 100
        default 52

    config HARDWARE_SPEAKER_VER
        int "Select HARDWARE_SPEAKER_VER"
        range 0 8
        default 0

    choice G722_CODEC_RUN_CPU
        prompt "Select G722 Codec run cpu"
        default G722_CODEC_RUN_ON_CPU1

        config G722_CODEC_RUN_ON_CPU1
            bool "Select g722 codec run on cpu1"
        config G722_CODEC_RUN_ON_CPU0
            bool "Select g722 codec run on cpu0"
    endchoice

    config ENABLE_AGORA_DATASTREAM
        bool "Enable Agora DataStream message processing"
        default n

    config HTTP_AGENT_ENABLE_MQTT
        bool "Enable Entity MQTT management channel"
        default n
        help
            Enable only when this product needs MQTT report/issue/OTA management.
            HTTP AI start/stop uses Device API and does not require MQTT.

    config HTTP_AGENT_ENABLE_BLE_PROVISIONING
        bool "Enable BLE provisioning compatibility path"
        default n
        help
            Enable only when this product needs BLE provisioning. The HTTP agent
            POC uses AP+STA web provisioning, so BLE is disabled by default to
            avoid reserving BT/BLE resources during RTC audio.
endmenu
```
